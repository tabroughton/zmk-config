## boards/shields/nice_view_cs_override/Kconfig.shield
```kconfig
config SHIELD_NICE_VIEW_CS_OVERRIDE
    def_bool $(shields_list_contains,nice_view_cs_override)
```

## config/west.yml
```yaml
manifest:
  defaults:
    revision: v0.3
  remotes:
    - name: zmkfirmware
      url-base: https://github.com/zmkfirmware
    - name: m165437
      url-base: https://github.com/M165437
    - name: caksoylar
      url-base: https://github.com/caksoylar
  projects:
    - name: zmk
      remote: zmkfirmware
      import: app/west.yml    
    - name: nice-view-gem
      remote: m165437
      revision: main
    - name: zmk-rgbled-widget
      remote: caksoylar
      revision: main
  self:
    path: config
```
